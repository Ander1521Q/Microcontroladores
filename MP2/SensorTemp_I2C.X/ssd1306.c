#include "ssd1306.h"

// Buffer de pantalla para evitar parpadeo
uint8_t screen_buffer[1024]; // 128x64 bits = 1024 bytes

// Fuente 5x7 mejorada con minúsculas (ASCII 32-127)
const uint8_t font5x7[][5] = {
    {0x00,0x00,0x00,0x00,0x00}, // space 32
    {0x00,0x00,0x5F,0x00,0x00}, // !
    {0x00,0x07,0x00,0x07,0x00}, // "
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    {0x00,0x01,0x02,0x04,0x00}, // `
    // Minúsculas (97-122)
    {0x20,0x54,0x54,0x54,0x78}, // a
    {0x7F,0x48,0x44,0x44,0x38}, // b
    {0x38,0x44,0x44,0x44,0x20}, // c
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    {0x44,0x64,0x54,0x4C,0x44}  // z
};

void OLED_Command(uint8_t cmd) {
    I2C_Start();
    I2C_Write(SSD1306_ADDR);
    I2C_Write(0x00);
    I2C_Write(cmd);
    I2C_Stop();
}

void OLED_Data(uint8_t data) {
    I2C_Start();
    I2C_Write(SSD1306_ADDR);
    I2C_Write(0x40);
    I2C_Write(data);
    I2C_Stop();
}

void OLED_Init(void) {
    __delay_ms(100);
    
    // Secuencia de inicialización mejorada
    OLED_Command(0xAE); // Display OFF
    OLED_Command(0x20); OLED_Command(0x00); // Horizontal addressing mode
    OLED_Command(0x21); OLED_Command(0x00); OLED_Command(0x7F); // Column address
    OLED_Command(0x22); OLED_Command(0x00); OLED_Command(0x07); // Page address
    OLED_Command(0x8D); OLED_Command(0x14); // Charge pump
    OLED_Command(0xA1); // Segment remap
    OLED_Command(0xC8); // COM output scan direction
    OLED_Command(0xDA); OLED_Command(0x12); // COM pins hardware configuration
    OLED_Command(0x81); OLED_Command(0x7F); // Contrast
    OLED_Command(0xD9); OLED_Command(0xF1); // Pre-charge period
    OLED_Command(0xDB); OLED_Command(0x40); // VCOMH deselect level
    OLED_Command(0xA4); // Entire display ON
    OLED_Command(0xA6); // Normal display
    OLED_Command(0xAF); // Display ON
    
    __delay_ms(100);
    OLED_Clear();
}

void OLED_Clear(void) {
    // Limpiar buffer
    for(uint16_t i = 0; i < 1024; i++) {
        screen_buffer[i] = 0x00;
    }
    // Limpiar pantalla física
    for (uint8_t page = 0; page < 8; page++) {
        OLED_Command(0xB0 + page);
        OLED_Command(0x00);
        OLED_Command(0x10);
        for (uint8_t i = 0; i < 128; i++) {
            OLED_Data(0x00);
        }
    }
}

void OLED_Update(void) {
    // Actualizar pantalla completa desde el buffer
    for (uint8_t page = 0; page < 8; page++) {
        OLED_Command(0xB0 + page);
        OLED_Command(0x00);
        OLED_Command(0x10);
        for (uint8_t col = 0; col < 128; col++) {
            OLED_Data(screen_buffer[page * 128 + col]);
        }
    }
}

void OLED_SetCursor(uint8_t x, uint8_t y) {
    OLED_Command(0xB0 + y);
    OLED_Command(0x00 + (x & 0x0F));
    OLED_Command(0x10 + ((x >> 4) & 0x0F));
}

void OLED_PrintChar(char c) {
    if (c < 0x20 || c > 0x7F) c = 0x20; // Carácter no válido ? espacio
    
    const uint8_t *bitmap;
    if (c >= 0x61 && c <= 0x7A) { // Minúsculas (a-z)
        bitmap = font5x7[c - 0x61 + 65]; // Offset para minúsculas
    } else {
        bitmap = font5x7[c - 0x20];
    }
    
    for (uint8_t i = 0; i < 5; i++) {
        OLED_Data(bitmap[i]);
    }
    OLED_Data(0x00); // Espacio entre caracteres
}

void OLED_PrintText(uint8_t x, uint8_t y, const char *str) {
    OLED_SetCursor(x, y);
    while (*str) {
        OLED_PrintChar(*str++);
    }
}

// Función mejorada para imprimir texto usando buffer
void OLED_PrintTextBuffered(uint8_t x, uint8_t y, const char *str) {
    uint16_t base_addr = y * 128 + x;
    uint8_t *buffer_ptr = &screen_buffer[base_addr];
    
    while (*str && x < 128) {
        char c = *str++;
        if (c < 0x20 || c > 0x7F) c = 0x20;
        
        const uint8_t *bitmap;
        if (c >= 0x61 && c <= 0x7A) { // Minúsculas
            bitmap = font5x7[c - 0x61 + 65];
        } else {
            bitmap = font5x7[c - 0x20];
        }
        
        // Copiar bitmap al buffer
        for (uint8_t i = 0; i < 5; i++) {
            if (x < 128) {
                *buffer_ptr++ = bitmap[i];
                x++;
            }
        }
        // Espacio entre caracteres
        if (x < 128) {
            *buffer_ptr++ = 0x00;
            x++;
        }
    }
}