#include "ssd1306.h"

// Fuente 5x7 para caracteres ASCII (0x20 - 0x7F)
const uint8_t font5x7[][5] = {
  {0x00,0x00,0x00,0x00,0x00}, // (espacio)
  {0x00,0x00,0x5F,0x00,0x00}, // !
  {0x00,0x07,0x00,0x07,0x00}, // "
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  {0x61,0x51,0x49,0x45,0x43}  // Z
};

void OLED_Command(uint8_t cmd) {
    I2C_Start();
    I2C_Write(SSD1306_ADDR);
    I2C_Write(0x00);  // Control byte - command
    I2C_Write(cmd);
    I2C_Stop();
}

void OLED_Data(uint8_t data) {
    I2C_Start();
    I2C_Write(SSD1306_ADDR);
    I2C_Write(0x40);  // Control byte - data
    I2C_Write(data);
    I2C_Stop();
}

void OLED_Init(void) {
    __delay_ms(100);  // Esperar que la OLED se estabilice
    
    // Secuencia de inicialización estándar para SSD1306
    OLED_Command(0xAE); // Display OFF
    
    OLED_Command(0x20); // Set Memory Addressing Mode
    OLED_Command(0x00); // Horizontal Addressing Mode
    
    OLED_Command(0xB0); // Set Page Start Address
    
    OLED_Command(0xC8); // Set COM Output Scan Direction
    
    OLED_Command(0x00); // Set low column address
    OLED_Command(0x10); // Set high column address
    OLED_Command(0x40); // Set start line address
    
    OLED_Command(0x81); // Set Contrast Control
    OLED_Command(0x7F); // Contrast value
    
    OLED_Command(0xA1); // Set Segment Re-map
    OLED_Command(0xA6); // Set Normal Display
    
    OLED_Command(0xA8); // Set Multiplex Ratio
    OLED_Command(0x3F); // 64MUX
    
    OLED_Command(0xA4); // Entire Display ON (resume)
    
    OLED_Command(0xD3); // Set Display Offset
    OLED_Command(0x00); // No offset
    
    OLED_Command(0xD5); // Set Display Clock Divide Ratio/Oscillator Frequency
    OLED_Command(0x80); // Set divide ratio
    
    OLED_Command(0xD9); // Set Pre-charge Period
    OLED_Command(0xF1); // Phase 1: 1 DCLK, Phase 2: 15 DCLKs
    
    OLED_Command(0xDA); // Set COM Pins Hardware Configuration
    OLED_Command(0x12); // Alternative COM pin configuration
    
    OLED_Command(0xDB); // Set VCOMH Deselect Level
    OLED_Command(0x40); // VCOMH = ~0.77 x VCC
    
    OLED_Command(0x8D); // Set DC-DC enable
    OLED_Command(0x14); // Enable charge pump
    
    OLED_Command(0xAF); // Display ON
    
    __delay_ms(100);
    OLED_Clear(); // Limpiar pantalla
}

void OLED_Clear(void) {
    for (uint8_t page = 0; page < 8; page++) {
        OLED_Command(0xB0 + page); // Set page address
        OLED_Command(0x00);        // Set lower column address
        OLED_Command(0x10);        // Set higher column address
        
        // Limpiar toda la página
        for (uint8_t i = 0; i < 128; i++) {
            OLED_Data(0x00); // Todos los píxeles apagados
        }
    }
}

void OLED_SetCursor(uint8_t x, uint8_t y) {
    if(x > 127) x = 127;
    if(y > 7) y = 7;
    
    OLED_Command(0xB0 + y);                    // Set page address
    OLED_Command(0x00 + (x & 0x0F));          // Set lower column address
    OLED_Command(0x10 + ((x >> 4) & 0x0F));   // Set higher column address
}

void OLED_PrintChar(char c) {
    if (c < 0x20 || c > 0x7F) c = 0x20; // Carácter no válido -> espacio
    const uint8_t *bitmap = font5x7[c - 0x20];
    for (uint8_t i = 0; i < 5; i++) {
        OLED_Data(bitmap[i]);
    }
    OLED_Data(0x00); // Espacio entre caracteres
}

void OLED_PrintText(uint8_t x, uint8_t y, const char *str) {
    OLED_SetCursor(x, y);
    while (*str) {
        OLED_PrintChar(*str++);
    }
}