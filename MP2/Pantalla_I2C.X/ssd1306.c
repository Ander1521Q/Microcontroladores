/*
 * File:   ssd1306.c
 * Author: ANDER
 *
 * Created on 5 de noviembre de 2025, 10:42 AM
 */


#include "ssd1306.h"

// Fuente 5x7 para caracteres ASCII (0x20 - 0x7F)
const uint8_t font5x7[][5] = {
  // Caracteres desde el espacio (0x20)
  {0x00,0x00,0x00,0x00,0x00}, // (espacio)
  {0x00,0x00,0x5F,0x00,0x00}, // !
  {0x00,0x07,0x00,0x07,0x00}, // "
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  {0x61,0x51,0x49,0x45,0x43}  // Z
};

// --- Funciones del OLED ---
void OLED_Command(uint8_t cmd) {
    I2C_Start();
    I2C_Write(SSD1306_ADDR);
    I2C_Write(0x00);
    I2C_Write(cmd);
    I2C_Stop();
}

void OLED_Data(uint8_t data) {
    I2C_Start();
    I2C_Write(SSD1306_ADDR);
    I2C_Write(0x40);
    I2C_Write(data);
    I2C_Stop();
}

void OLED_Init(void) {
    __delay_ms(100);
    OLED_Command(0xAE);
    OLED_Command(0xD5); OLED_Command(0x80);
    OLED_Command(0xA8); OLED_Command(0x3F);
    OLED_Command(0xD3); OLED_Command(0x00);
    OLED_Command(0x40);
    OLED_Command(0x8D); OLED_Command(0x14);
    OLED_Command(0x20); OLED_Command(0x00);
    OLED_Command(0xA1);
    OLED_Command(0xC8);
    OLED_Command(0xDA); OLED_Command(0x12);
    OLED_Command(0x81); OLED_Command(0x7F);
    OLED_Command(0xD9); OLED_Command(0xF1);
    OLED_Command(0xDB); OLED_Command(0x40);
    OLED_Command(0xA4);
    OLED_Command(0xA6);
    OLED_Command(0xAF);
}

void OLED_Clear(void) {
    for (uint8_t page = 0; page < 8; page++) {
        OLED_Command(0xB0 + page);
        OLED_Command(0x00);
        OLED_Command(0x10);
        for (uint8_t i = 0; i < 128; i++) {
            OLED_Data(0x00);
        }
    }
}

void OLED_SetCursor(uint8_t x, uint8_t y) {
    OLED_Command(0xB0 + y);
    OLED_Command(0x00 + (x & 0x0F));
    OLED_Command(0x10 + ((x >> 4) & 0x0F));
}

void OLED_PrintChar(char c) {
    if (c < 0x20 || c > 0x7F) c = 0x20;
    const uint8_t *bitmap = font5x7[c - 0x20];
    for (uint8_t i = 0; i < 5; i++) OLED_Data(bitmap[i]);
    OLED_Data(0x00);
}

void OLED_PrintText(uint8_t x, uint8_t y, const char *str) {
    OLED_SetCursor(x, y);
    while (*str) OLED_PrintChar(*str++);
}

